#include <Servo.h>
#include <Adafruit_LSM6DSOX.h>
#include <math.h>
#include <stdio.h>

// For SPI mode, we need a CS pin
#define LSM_CS 10
// For software-SPI mode we need SCK/MOSI/MISO pins
#define LSM_SCK 13
#define LSM_MISO 12
#define LSM_MOSI 11

// Temporary test values for walking motion in txt file
#define ROWS = 174
#define COLS = 6

// the sensor
Adafruit_LSM6DSOX sox;

// the servos
Servo left_hip_1;
Servo left_hip_2;
Servo left_hip_3;
Servo left_knee; // higher is back
Servo left_ankle_1;
Servo left_ankle_2;
Servo right_hip_1;
Servo right_hip_2;
Servo right_hip_3;
Servo right_knee; // Higher is forward
Servo right_ankle_1;
Servo right_ankle_2;

//this is the array of data for movement from the simulink simulation
int step_data[][12] = {
{0, 0, 0, 0, 0, 0, 0, 0, 0, 0, 0, 0},
{0, 0, 0, 0, 0, 0, 0, 0, 0, 0, 0, 0},
{0, 0, 0, 0, 0, 0, 0, 0, 0, 0, 0, 0},
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{0, 33120, -328, -98691, 328, 65571, 0, -61121, -2100, 99350, 2100, -38230},

};

// variable for the rolling index of the steps
int step_data_index;

//turns a slice of the movement array into angles for the motors to read, a is for angles
void translateangles(float a[], int a_size) {
  a[0] = (a[0] / 100000.0 * (-1) + 97 * M_PI / 180.0) * 180 / M_PI;
  a[1] = (a[1] / 100000.0 * (-1) + M_PI * 93 / 180.0) * 180 / M_PI;
  a[2] = (a[2] / 100000.0 + 90 * M_PI / 180.0) * 180 / M_PI;
  a[3] = (a[3] / 100000.0 + 32 * M_PI / 180.0) * 180 / M_PI;
  a[4] = (a[4] / 100000.0 + 95 * M_PI / 180.0) * 180 / M_PI;
  a[5] = (a[5] / 100000.0 * (-1) + 95 * M_PI / 180) * 180 / M_PI;
  a[6] = (a[6] / 100000.0 + 90 * M_PI / 180.0) * 180 / M_PI;
  a[7] = (a[7] / 100000.0 + M_PI * 105 / 180.0) * 180 / M_PI;
  a[8] = (a[8] / 100000.0 * (-1) + 90 * M_PI / 180.0) * 180 / M_PI;
  a[9] = (a[9] / 100000.0 * (-1) + 148 * M_PI / 180.0) * 180 / M_PI;
  a[10] = (a[10] / 100000.0 * (-1) + 90 * M_PI / 180.0) * 180 / M_PI;
  a[11] = (a[11] / 100000.0 + 75 * M_PI / 180.0) * 180 / M_PI;

  // print the angles
  for (int i = 0; i < 12; i += 1) {
    Serial.print(a[i]);
    Serial.print(", ");
  }
  Serial.println();
}

//runs once as it first starts
void setup() {
  
  // initialize step_data_index as 0
  step_data_index = 0;

  // begin a serial connection to print values to the computer
  Serial.begin(115200);
  while (!Serial)
    delay(10); // will pause Zero, Leonardo, etc until serial console opens

  // once it gets past this, the arduino is connected
  Serial.println("Connected!");

  // connect to the I2C protocol which the sensor uses
  if (!sox.begin_I2C()) {
    while (1) {
      delay(10);
    }
  }

  // once it passes this, say the sensor is found
  Serial.println("LSM6DSOX Found!");

  // attach all of the servos to the correct pin
  left_hip_1.attach(2);
  left_hip_2.attach(3);
  left_hip_3.attach(4);
  left_knee.attach(5);
  left_ankle_1.attach(6);
  left_ankle_2.attach(7);
  right_hip_1.attach(8);
  right_hip_2.attach(9);
  right_hip_3.attach(10);
  right_knee.attach(11);
  right_ankle_1.attach(12);
  right_ankle_2.attach(13);

  // start the robot standing
  left_hip_1.write(97); //97 + is curve in - is curve out
  left_hip_2.write(93); //93 + is back - is forward
  left_hip_3.write(90); //90 + is in - is out
  left_knee.write(32); //32 + is back - is forward
  left_ankle_1.write(95); //95 + is in - is out
  left_ankle_2.write(95); //95 + is back - is forward

  right_hip_1.write(90); //90 + is curve out - is curve in
  right_hip_2.write(105); //105 + is forward - is back
  right_hip_3.write(90); //90 + is out - is in
  right_knee.write(148); //148 + is forward - is back
  right_ankle_1.write(90); //90 + is in - is out
  right_ankle_2.write(75); //75 + is forward - is back

  // wait five seconds
  delay(5000);
}

float a[12];
// this part of the code runs continuously
void loop() {
  
  // make a list, a, for the angles inside a slice of the movement data array
  for (int i = 0; i < 12; i++) {
    a[i] = step_data[step_data_index][i];
    //Serial.print(step_data[step_data_index][i]);
    //Serial.print(a[i]);
    //Serial.print(", ");
    }
  Serial.println(step_data_index);

  // increment the movement data index, or reset it
  step_data_index = step_data_index + 1;
  if (step_data_index >= 174) {
    step_data_index = 0;
  }
  //Serial.println();

  // turn the int angles into angles for the servos to read
  translateangles(a, sizeof(a));

  // write the angles to each servo
  // left_hip_1.write(a[0]);
  // left_hip_2.write(a[1]);
  // left_hip_3.write(a[2]);
  // left_knee.write(a[3]);
  // left_ankle_1.write(a[4]);
  // left_ankle_2.write(a[5]);
  
  right_hip_1.write(a[6]);
  right_hip_2.write(a[7]);
  right_hip_3.write(a[8]);
  right_knee.write(a[9]);
  right_ankle_1.write(a[10]);
  right_ankle_2.write(a[11]);


  delay(16);
}